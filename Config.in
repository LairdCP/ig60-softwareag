## Config.in
```kconfig
source "$BR2_EXTERNAL_SOFTWAREAG_PATH/package/cumulocity-sdk-c/Config.in"
source "$BR2_EXTERNAL_SOFTWAREAG_PATH/package/cumulocity-agent/Config.in"
source "$BR2_EXTERNAL_SOFTWAREAG_PATH/package/eth-static-ip/Config.in"
source "$BR2_EXTERNAL_SOFTWAREAG_PATH/package/ig-lte-manager/Config.in"
source "$BR2_EXTERNAL_SOFTWAREAG_PATH/package/ig-rs485/Config.in"
source "$BR2_EXTERNAL_SOFTWAREAG_PATH/package/rogers-config/Config.in"
```

## package/cumulocity-agent/Config.in
```kconfig
config BR2_PACKAGE_CUMULOCITY_AGENT
	bool "cumulocity-agent"
	select BR2_PACKAGE_CUMULOCITY_SDK_C
	select BR2_PACKAGE_LIBMODBUS
	help
	  Cumulocity Agent for IG60

	  http://www.softwareag.com/
```

## package/cumulocity-sdk-c/Config.in
```kconfig
config BR2_PACKAGE_CUMULOCITY_SDK_C
	bool "cumulocity-sdk-c"
	select BR2_PACKAGE_LIBCURL
	select BR2_PACKAGE_LUA
	help
	  Cumulocity SDK for C

	  http://www.softwareag.com/
```

## package/eth-static-ip/Config.in
```kconfig
config BR2_PACKAGE_ETH_STATIC_IP
	bool "eth-static-ip"
	help
	  Configure static IP address for Ethernet
```

## package/ig-lte-manager/Config.in
```kconfig
config BR2_PACKAGE_IG_LTE_MANAGER
	bool "ig-lte-manager"
	help
	  LTE Modem Manager service for IG60
```

## package/ig-rs485/Config.in
```kconfig
config BR2_PACKAGE_IG_RS485
	bool "ig-rs485"
	help
	  Configure serial port for RS-485 at boot
```

## package/pyads/Config.in
```kconfig
config BR2_PACKAGE_PYADS
	bool "pyads"
	help
	  https://github.com/chwiede/pyads
```

## package/rogers-config/Config.in
```kconfig
config BR2_PACKAGE_ROGERS_CONFIG
	bool "rogers-config"
	depends on BR2_PACKAGE_CUMULOCITY_AGENT
	help
	  Configuration file for Rogers Machinery
```
